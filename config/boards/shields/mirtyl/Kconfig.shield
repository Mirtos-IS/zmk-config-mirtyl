## config/boards/shields/mirtyl/Kconfig.shield
```kconfig
config SHIELD_MIRTYL_LEFT
    def_bool $(shields_list_contains,mirtyl_left)

config SHIELD_MIRTYL_RIGHT
    def_bool $(shields_list_contains,mirtyl_right)
```
